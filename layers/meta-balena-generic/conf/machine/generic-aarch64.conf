## layers/meta-balena-generic/conf/machine/generic-aarch64.conf
```bitbake
#@TYPE: Machine
#@NAME: Generic aarch64
#@DESCRIPTION: Machine configuration for Generic aarch64

require conf/machine/include/arm/arch-armv8a.inc

MACHINE_FEATURES += " efi"

PREFERRED_PROVIDER_virtual/kernel ?= "linux-yocto"
MACHINE_EXTRA_RRECOMMENDS += "kernel-modules linux-firmware"

KERNEL_IMAGETYPE = "Image.gz"

DEFAULTTUNE ?= "aarch64"
SERIAL_CONSOLES = "115200;ttyAMA0"
```

## layers/meta-balena-generic/conf/machine/generic-amd64-fde.conf
```bitbake
#@TYPE: Machine
#@NAME: Generic amd64 with FDE
#@DESCRIPTION: Machine configuration for Generic amd64 with FDE

MACHINEOVERRIDES = "generic-amd64:${MACHINE}"
include conf/machine/generic-amd64.conf
```

## layers/meta-balena-generic/conf/machine/generic-amd64.conf
```bitbake
#@TYPE: Machine
#@NAME: Generic amd64
#@DESCRIPTION: Machine configuration for Generic amd64

MACHINE_FEATURES += " efi"

PREFERRED_PROVIDER_virtual/kernel ?= "linux-yocto"
MACHINE_EXTRA_RRECOMMENDS += "kernel-modules linux-firmware"

KERNEL_IMAGETYPE ?= "bzImage"

DEFAULTTUNE ?= "core2-64"
require conf/machine/include/tune-core2.inc
```
